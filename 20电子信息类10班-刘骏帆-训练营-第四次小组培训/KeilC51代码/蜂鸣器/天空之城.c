#include <reg52.h>
#include <intrins.h>
 
sbit   speaker = P0^0;
unsigned char timer0h, timer0l, time;
 
//--------------------------------------
// 单片机晶振采用 11.0592MHz
// 频率- 半周期数据表 高八位 本软件共保存了四个八度的 28 个频率数据
code unsigned char FREQH[] = {
                                0xF2, 0xF3, 0xF5, 0xF5, 0xF6, 0xF7, 0xF8,       // 低音 1234567
                                0xF9, 0xF9, 0xFA, 0xFA, 0xFB, 0xFB, 0xFC, 0xFC, // 中音1,2,3,4,5,6,7,i
                                0xFC, 0xFD, 0xFD, 0xFD, 0xFD, 0xFE,             // 高音 234567
                                0xFE, 0xFE, 0xFE, 0xFE, 0xFE, 0xFE, 0xFF        // 超高音 1234567
                             }; 
// 频率- 半周期数据表 低八位
code unsigned char FREQL[] = {
                                0x42, 0xC1, 0x17, 0xB6, 0xD0, 0xD1, 0xB6,       // 低音 1234567
                                0x21, 0xE1, 0x8C, 0xD8, 0x68, 0xE9, 0x5B, 0x8F, // 中音1,2,3,4,5,6,7,i
                                0xEE, 0x44, 0x6B, 0xB4, 0xF4, 0x2D,             // 高音 234567
                                0x47, 0x77, 0xA2, 0xB6, 0xDA, 0xFA, 0x16        // 超高音 1234567
                             };
 
code unsigned char sszymmh[] = {
                                    0,0,2,  0,0,2,  0,0,2,  6,1,1,  7,1,1,
                                    1,2,3,  7,1,1,  1,2,2,  3,2,2,
                                    7,1,4,  0,2,2,  3,1,1,  3,1,1,    
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                                    6,1,2,    
                               };
                             
void t0int() interrupt 1 //T0 中断程序，控制发音的音调
{
    TR0 = 0; // 先关闭 T0
    speaker = !speaker; // 输出方波 , 发音
    TH0 = timer0h; // 下次的中断时间 , 这个时间 , 控制音调高低
    TL0 = timer0l;
    TR0 = 1; // 启动 T0
}
//--------------------------------------
void delay(unsigned char t) // 延时程序，控制发音的时间长度
{
    unsigned char t1;
    unsigned long t2;
    for(t1 = 0; t1 < t; t1++) // 双重循环 , 共延时 t 个半拍
        for(t2 = 0; t2 < 8000; t2++); // 延时期间 , 可进入 T0 中断去发音
    TR0 = 0; // 关闭 T0, 停止发音
}
//--------------------------------------
void song() // 演奏一个音符
{
    TH0 = timer0h; // 控制音调
    TL0 = timer0l;
    TR0 = 1; // 启动 T0, 由 T0输出方波去发音
    delay(time); // 控制时间长度
}
//--------------------------------------
void main()
{
    unsigned char k, i;
    TMOD = 1; // 置 T0 定时工作方式 1
    ET0 = 1; // 开 T0 中断
    EA = 1; // 开 CPU中断
    
    
    while(1) 
    {
        i = 0;
        time = 1;
        while(time) 
        {
            k = sszymmh[i] + 7 * sszymmh[i + 1] - 1;
            // 第 i 个是音符 , 第 i+1 个是第几个八度
            timer0h = FREQH[k]; // 从数据表中读出频率数值
            timer0l = FREQL[k]; // 实际上 , 是定时的时间长度
            time = sszymmh[i + 2]; // 读出时间长度数值
            i += 3;
            song(); // 发出一个音符
        } 
    } 
}